#include <SPI.h>
#include <Wire.h>
#include <Adafruit_GFX.h>
#include <Adafruit_SSD1306.h>
#include <EasyButton.h>
#include "MAX30100_PulseOximeter.h"
#define BLYNK_PRINT Serial//redefine  BLYNK_PRINT as Serial
#include <ESP8266WiFi.h>//header file for controlling wifi
#include <BlynkSimpleEsp8266.h>//header for blynk
#include <TimeLib.h>//header file for counter
#include <WidgetRTC.h>// header file for Real Time Clock
#include "Ubidots.h"
long int update_timer=millis();
long int button_timer=millis();
#define BUTTON_PIN D7
PulseOximeter pox;
char context[50];
char lattitude[20];
char longitude[20];
int ThermistorPin =A0;
int Vo;
float R1 = 10000;
float logR2, R2, T, Tc, Tf;
float c1 = 1.009249522e-03, c2 = 2.378405444e-04, c3 = 2.019202697e-07;
int menu=1;
int beat=0;
int oxygen=0;
int heart=0;
int heart_screen=0;
int oxygen_screen=0;
char auth[] = "UB71V4l3KUa5QUivXLvhMKJ08C_5CuZL";// indentification of your board like phone number
const char* DEVICE_TYPE = "Renga";     // Edit here your device type label
const char* WIFI_SSID = "Renga";           // Put here your Wi-Fi SSID
const char* WIFI_PASS = "Renga#3112";           // Put here your Wi-Fi password
const char* UBIDOTS_TOKEN = "BBFF-6GE4gFg0YZHuCEn41imG8bJpyQ2Uqb";  // Put here your Ubidots TOKEN

// 'mm', 33x32px
const unsigned char thermometer [] PROGMEM = {
  0x00, 0x00, 0x00, 0x00, 0x00, 0x00, 0x00, 0x00, 0x00, 0x00, 0x00, 0x02, 0x20, 0x00, 0x00, 0x00, 
  0x04, 0x10, 0x00, 0x00, 0x00, 0x04, 0x10, 0x00, 0x00, 0x00, 0x04, 0x10, 0x00, 0x00, 0x00, 0x1c, 
  0x10, 0x00, 0x00, 0x00, 0x04, 0x10, 0x00, 0x00, 0x00, 0x04, 0x10, 0x00, 0x00, 0x00, 0x1c, 0x10, 
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  0x00, 0x00, 0x03, 0xe0, 0x00, 0x00, 0x00, 0x00, 0x00, 0x00, 0x00, 0x00, 0x00, 0x00, 0x00, 0x00
};


// '3e3e3e', 30x30px
const unsigned char satellite [] PROGMEM = {
  0x00, 0x00, 0x00, 0x00, 0x03, 0x00, 0x00, 0x00, 0x07, 0x80, 0x00, 0x00, 0x0f, 0x80, 0x00, 0x00, 
  0x07, 0x60, 0x00, 0x00, 0x02, 0xf0, 0x00, 0x00, 0x01, 0xf0, 0x00, 0x00, 0x00, 0xec, 0x00, 0x00, 
  0x00, 0x5e, 0x70, 0x00, 0x00, 0x3e, 0xf8, 0x00, 0x00, 0x1d, 0xfc, 0x00, 0x00, 0x0b, 0xfc, 0x00, 
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  0x03, 0xe0, 0x00, 0x00, 0x00, 0x40, 0x00, 0x00
};

// 'mml', 30x30px
const unsigned char heart_logo [] PROGMEM = {
  0x00, 0x00, 0x00, 0x00, 0x00, 0x00, 0x00, 0x00, 0x00, 0x00, 0x00, 0x00, 0x00, 0x00, 0x00, 0x00, 
  0x00, 0x00, 0x00, 0x00, 0x00, 0x00, 0x00, 0x00, 0x01, 0xf8, 0x7e, 0x00, 0x03, 0xfc, 0xff, 0x80, 
  0x07, 0xff, 0xff, 0x80, 0x0f, 0xff, 0xff, 0xc0, 0x0f, 0xff, 0xff, 0xc0, 0x0f, 0xff, 0xff, 0xc0, 
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  0x00, 0x00, 0x00, 0x00, 0x00, 0x00, 0x00, 0x00
};
// 'mml', 15x15px
const unsigned char heart_logo_small_1 [] PROGMEM = {
  0x00, 0x00, 0x00, 0x00, 0x00, 0x00, 0x1e, 0xf0, 0x3f, 0xf8, 0x3f, 0xf8, 0x3f, 0xf8, 0x1f, 0xf0, 
  0x0f, 0xe0, 0x07, 0xc0, 0x03, 0x80, 0x01, 0x00, 0x00, 0x00, 0x00, 0x00, 0x00, 0x00
};
// 'mml', 20x20px
const unsigned char heart_logo_small_2 [] PROGMEM = {
  0x00, 0x00, 0x00, 0x00, 0x00, 0x00, 0x00, 0x00, 0x00, 0x00, 0x00, 0x00, 0x0f, 0x9f, 0x00, 0x1f, 
  0xff, 0x80, 0x1f, 0xff, 0x80, 0x1f, 0xff, 0x80, 0x1f, 0xff, 0x80, 0x0f, 0xff, 0x80, 0x0f, 0xff, 
  0x00, 0x07, 0xfe, 0x00, 0x03, 0xfc, 0x00, 0x01, 0xf8, 0x00, 0x00, 0xf0, 0x00, 0x00, 0x60, 0x00, 
  0x00, 0x00, 0x00, 0x00, 0x00, 0x00, 0x00, 0x00, 0x00, 0x00, 0x00, 0x00
};

// 'dsds', 30x30px
const unsigned char black [] PROGMEM = {
  0x00, 0x00, 0x00, 0x00, 0x00, 0x00, 0x00, 0x00, 0x00, 0x00, 0x00, 0x00, 0x00, 0x00, 0x00, 0x00, 
  0x00, 0x00, 0x00, 0x00, 0x00, 0x00, 0x00, 0x00, 0x00, 0x00, 0x00, 0x00, 0x00, 0x00, 0x00, 0x00, 
  0x00, 0x00, 0x00, 0x00, 0x00, 0x00, 0x00, 0x00, 0x00, 0x00, 0x00, 0x00, 0x00, 0x00, 0x00, 0x00, 
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  0x00, 0x00, 0x00, 0x00, 0x00, 0x00, 0x00, 0x00
};
// 'ewew', 30x30px
const unsigned char lung_logo [] PROGMEM = {
  0x00, 0x00, 0x00, 0x00, 0x00, 0x00, 0x00, 0x00, 0x00, 0x01, 0x00, 0x00, 0x00, 0x03, 0x00, 0x00, 
  0x00, 0x00, 0x00, 0x00, 0x00, 0x01, 0x00, 0x00, 0x00, 0x03, 0x00, 0x00, 0x00, 0x38, 0x30, 0x00, 
  0x00, 0xfb, 0x7c, 0x00, 0x01, 0xf9, 0x7e, 0x00, 0x03, 0xfa, 0x7f, 0x00, 0x07, 0xfb, 0x7f, 0x80, 
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  0x00, 0x00, 0x00, 0x00, 0x00, 0x00, 0x00, 0x00
};
// 'dsdsd', 30x30px
const unsigned char o_logo [] PROGMEM = {
  0x00, 0x00, 0x00, 0x00, 0x00, 0x00, 0x00, 0x00, 0x00, 0x18, 0x00, 0x00, 0x00, 0x3c, 0x30, 0x00, 
  0x00, 0x78, 0xec, 0x00, 0x00, 0x39, 0xc4, 0x00, 0x00, 0x01, 0x82, 0x00, 0x00, 0x02, 0x02, 0x00, 
  0x00, 0x00, 0x02, 0x00, 0x00, 0x01, 0x04, 0x00, 0x00, 0x00, 0xc8, 0x00, 0x00, 0xfe, 0x20, 0x00, 
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  0x00, 0x00, 0x00, 0x00, 0x00, 0x00, 0x00, 0x00
};
// 'asas', 30x30px
const unsigned char o2_logo [] PROGMEM = {
  0x00, 0x00, 0x00, 0x00, 0x00, 0x00, 0x00, 0x00, 0x00, 0x00, 0x00, 0x00, 0x00, 0x7f, 0x00, 0x00, 
  0x01, 0xff, 0xe0, 0x00, 0x03, 0xff, 0xf0, 0x00, 0x07, 0xc0, 0xf8, 0x00, 0x0f, 0x00, 0x78, 0x00, 
  0x0f, 0x00, 0x3c, 0x00, 0x0e, 0x00, 0x3c, 0x00, 0x1e, 0x00, 0x1c, 0x00, 0x1e, 0x00, 0x1c, 0x00, 
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  0x00, 0x00, 0x00, 0x00, 0x00, 0x00, 0x00, 0x00
};

Ubidots ubidots(UBIDOTS_TOKEN, UBI_HTTP);
Adafruit_SSD1306 display(-1);
EasyButton button(BUTTON_PIN,60,false,false);
BlynkTimer timer;// creating timer
WidgetRTC rtc;//creating real time clock
WidgetLCD lcd(V3);


/*===================== RTC ==========================*/
BLYNK_CONNECTED() {
  rtc.begin();// Synchronize time on connection //getting current time from network
  GpsParam gps();
}


/*===================== DECTECTING STATUS ==========================*/
void onBeatDetected()
{
    beat=1;
}


/*===================== UPDATING MENU ==========================*/
void update_menu()
{
  if(millis()-button_timer>300)
  {
  menu++;
  button_timer=millis();
  if(menu>5)
  {
    menu=1;
  }
  display.clearDisplay();
  }
 
}
/*===================== MENU 1: CLOCK_DISPLAY ==========================*/
void clock_display()
{
  
  display.setTextColor(WHITE, BLACK);
  display.drawRect(117, 25, 3, 3, WHITE);     // Put degree symbol ( ° )
  draw_text(0, 25, "TEMPERATURE =", 1);
  draw_text(122, 25, "C", 1);
  /*============Display Date=================*/
  display.setTextSize(1);
  display.setCursor(0,0);
  display.print(dayStr(weekday()));
  char currentDate [16];
  uint8_t thisDay, thisMonth ;
  thisDay = day();
  thisMonth =  month();
  sprintf (currentDate, "%02d/%02d/", thisDay, thisMonth); //add leading zeros to the day and month
  display.setTextSize(1);
  display.setCursor(62,0);
  display.print(currentDate);
  display.setTextSize(1);
  display.setCursor(102,0);
  display.print(year(), DEC);
  /*================Display Time================*/ 
  char buffer [16];
  uint8_t thisSec, thisMin, thisHour;
  thisSec = second();
  thisMin =  minute();
  thisHour = hour();
  sprintf (buffer, "%02d:%02d:%02d", thisHour, thisMin, thisSec);
  display.setCursor(0,9);
  
  display.setTextSize(2);
  display.print(" ");
  display.setCursor(15,9);
  display.print(buffer);
  /*=============Display Temperature=====================*/
  display.setTextSize(1);
  display.setCursor(82,25);
  display.print(Tc);

  display.display(); 
  lcd.print(0,0,"     ACTIVE     ");
  lcd.print(0,1,"     TRACKER    ");

 }
void draw_text(byte x_pos, byte y_pos, char *text, byte text_size) {
  display.setCursor(x_pos, y_pos);
  display.setTextSize(text_size);
  display.print(text);
  display.display();
}

/*===================== MENU 2: HEART_RATE ==========================*/
void heart_rate(int i)
{
 
  
  pox.update();
  heart=pox.getHeartRate();
  if(i==1)
  {
  Serial.println("heart");
  Serial.println(heart);
   display.clearDisplay();
   display.setCursor(0,0);
   display.setTextSize(1);
   //display.setTextColor(WHITE);
   display.println("HEART RATE");
   display.setTextSize(2);
   display.setCursor(0,9);
   display.print(heart);
   display.setCursor(0,25);
   display.setTextSize(1);
    display.print("  BPM");
   if(heart_screen>=0 && heart_screen <5)
   {
  
    display.drawBitmap(90, 0,black,30,30, WHITE);
   display.drawBitmap(90, 0,heart_logo_small_1,15,15, WHITE);
   
   }
   else if(heart_screen>=5 && heart_screen<10)
   {
   display.drawBitmap(90, 0,black,30,30, WHITE);
   display.drawBitmap(90, 0,heart_logo_small_2,20,20, WHITE);
   
   }
   else if(heart_screen>=10 && heart_screen<15)
   {
    display.drawBitmap(90, 0,heart_logo, 30,30, WHITE);

   
   }
   display.display();
   heart_screen++;
   if(heart_screen>14)
   {
    heart_screen=0;
   }
   lcd.print(0, 0, "   Heart Rate   "); 
   lcd.print(0,1,"     ");
   lcd.print(4, 1,"   ");
   lcd.print(4, 1, heart);
   lcd.print(7, 1,"Bpm     ");
  }
 
}

/*===================== MENU 3: OXYGEN_LEVEL ==========================*/
void oxygen_level(int i)
{
  pox.update();
  oxygen=pox.getSpO2();
  if(i==1)
  {
  Serial.println("Oxygen");
  Serial.println(oxygen);
   display.clearDisplay();
   display.setCursor(0,0);
   display.setTextSize(1);
   //display.setTextColor(WHITE);
   display.println("Oxygen_level");
   display.setTextSize(2);
   display.setCursor(0,9);
   display.print(oxygen);
    display.print("%");
   if(oxygen_screen>=0 && oxygen_screen<10)
   {
   display.drawBitmap(90, 0,lung_logo, 30,30, WHITE);
   
   }
   else if(oxygen_screen>=10 && oxygen_screen<20)
   {
   
   display.drawBitmap(90, 0,o_logo,30,30, WHITE);
   
   }
  
   display.display();
   oxygen_screen++;
   if(oxygen_screen>19)
   {
    oxygen_screen=1;
   }
   lcd.print(0, 0, "  Oxygen_level  "); 
   lcd.print(0,1,"      ");
   lcd.print(5, 1,"   ");
   lcd.print(5,1,oxygen);
   lcd.print(8,1,"%     ");
  }
 
}

/*===================== MENU 4: TEMPERATURE ==========================*/
void temperature(int i)
{
  
  Vo = analogRead(ThermistorPin);
  R2 = R1 * (1023.0 / (float)Vo - 1.0);
  logR2 = log(R2);
  T = (1.0 / (c1 + c2*logR2 + c3*logR2*logR2*logR2));
  Tc = T - 273.15;
  Tf = (Tc * 9.0)/5.0 + 32.0; 
  if(i==1)
  {
  Serial.print("Temperature: "); 
  Serial.print(Tf);
  Serial.print(" F; ");
  Serial.print(Tc);
  Serial.println(" C");  
  display.clearDisplay();
  display.setCursor(0,0);
  display.setTextSize(2);
  display.println(Tc,1);
  display.setCursor(50,0);
  display.setTextSize(1);
  display.print("o");
  display.setCursor(60,0);
  display.setTextSize(2);
  display.print("C");
  display.setCursor(0,16);
  display.println(Tf,1);
  display.setCursor(50,16);
  display.setTextSize(1);
  display.print("o");
  display.setCursor(60,16);
  display.setTextSize(2);
  display.print("F");
  display.drawBitmap(85, 0,thermometer, 33,32, WHITE);
  display.display();
  
   lcd.print(0,0,"Body Temperature");
   lcd.print(0,1,int(Tc));
   lcd.print(3,1,"°C   ");
   lcd.print(8,1,int(Tf));
   lcd.print(10,1,"°F     ");
  
  }
}

/*===================== MENU 5: GPS_STATUS ==========================*/
 BLYNK_WRITE(V4) 
  {
   GpsParam gps(param);
   sprintf(context,"lat=%.6f$lng=%.6f",gps.getLat(),gps.getLon());
   ubidots.add("position",1,context); 
   sprintf(lattitude,"lat=%.6f",gps.getLat());
   sprintf(longitude,"lng=%.6f",gps.getLon());
 }
void gps()
{
 
  
  Serial.println(lattitude);
  Serial.println();
  Serial.println(longitude);
  display.clearDisplay();
  display.setTextSize(1);
  display.setCursor(0,0);
  display.setTextSize(2);
  display.println("  GPS");
  display.setTextSize(1);
  display.println(lattitude);
  display.println(longitude);
  display.drawBitmap(90, 0,satellite, 30,30, WHITE);
  display.display();
   lcd.print(0,0,lattitude);
   lcd.print(0,1,longitude);
  lcd.print(13, 0,"   ");
  lcd.print(13, 1,"   ");
  
}

void ubi_dots()
{
  ubidots.add("Temperature",Tf);  // Change for your variable name
  ubidots.add("heart_rate", heart);
  ubidots.add("oxygen_level", oxygen);
  bool bufferSent = false;
  bufferSent = ubidots.send();  // Will send data to a device label that matches the device Id
  Blynk.virtualWrite(V0,Tf);
  Blynk.virtualWrite(V1,heart);
  Blynk.virtualWrite(V2,oxygen);
  if(Tf>103)
  {
    Blynk.email("rengarider31@gmail.com", "Patient:Renga","Temperature is beyond normal");
  }
  if(heart>103)
  {
    Blynk.email("rengarider31@gmail.com", "Patient:Renga","Heart rate is beyond normal");
  }
  if(oxygen<90 &&oxygen >0)
  {
    Blynk.email("rengarider31@gmail.com", "Patient:Renga","Oxygen level is less than  normal");
  }
  
}


void setup() {
  
   Serial.begin(115200);
   display.begin(SSD1306_SWITCHCAPVCC, 0x3C);  
   display.clearDisplay();
   button.begin();
   button.enableInterrupt(update_menu); // enabling interrupt to call update_menu function
   pox.setOnBeatDetectedCallback(onBeatDetected);
   display.setTextSize(2);
   display.setTextColor(WHITE);
   display.println("CONNECTING");
   display.println("  TO NET  ");
   display.display();
   ubidots.wifiConnect(WIFI_SSID, WIFI_PASS);
   ubidots.setDeviceType(DEVICE_TYPE);
   Blynk.begin(auth,WIFI_SSID,WIFI_PASS);// connecting to Network
   display.clearDisplay();
   setSyncInterval(10* 60); //every 10min the system will sync the time from internet
   //timer.setInterval(60000L, clockDisplay);
   lcd.clear(); //Use it to clear the LCD Widget
   lcd.print(0,0,"     ACTIVE     ");
   lcd.print(0,1,"     TRACKER    ");
   heart_rate(0);
   oxygen_level(0);
   temperature(0);
}


void loop() {
 
  if(millis()-update_timer>60000)
  {
   update_timer=millis();
   heart_rate(0);
   oxygen_level(0);
   temperature(0);
   ubi_dots();
  }
  if(menu==1)
  {
   clock_display();
   delay(100);
  }
  else if(menu==2)
  {
   heart_rate(1);
   delay(150);
  }
  else if(menu==3)
  {
   oxygen_level(1);
   delay(150);
  }
  else if(menu==4)
  {
    temperature(1);
    delay(150);
  }
  else if(menu==5)
  {
    gps();
    
    delay(100);
  }
  else
  {
    menu=1;
  }
  Blynk.run();//communicate to mobile
  
}
